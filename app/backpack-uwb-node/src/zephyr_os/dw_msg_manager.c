/************************************************************************************************************
Module:       dw_msg_manager

Revision:     1.0

Description:  ---

Notes:        ---

History:
Date          Name      Changes
-----------   ----
-------------------------------------------------------------------------------------
03/29/2024    TH       Began Coding    (TH = Toan Huynh)

COPYRIGHT © 2024 TOAN HUYNH. ALL RIGHTS RESERVED.

THIS SOURCE IS TOAN HUYNH PROPRIETARY AND CONFIDENTIAL! NO PART OF THIS
SOURCE MAY BE DISCLOSED IN ANY MANNER TO A THIRD PARTY WITHOUT PRIOR WRITTEN
CONSENT OF TOAN HUYNH.
************************************************************************************************************/

// ###########################################################################################################
//       #INCLUDES
// ###########################################################################################################
#include <zephyr/kernel.h>
#include <zephyr/random/random.h>
#include <zephyr/sys/hash_map.h>
#include <instance.h>
#include <host_msg.h>
#include <packet.h>
// #include <host_connection.h>

// ###########################################################################################################
//       TESTING #DEFINES
// ###########################################################################################################

// ###########################################################################################################
//       CONSTANT #DEFINES
// ###########################################################################################################

// ###########################################################################################################
//       MACROS
// ###########################################################################################################

// ###########################################################################################################
//       MODULE TYPES
// ###########################################################################################################
typedef struct {
  uint8_t* p_data;
  uint32_t data_len;
} msg_storage_t;

// ###########################################################################################################
//       CONSTANTS
// ###########################################################################################################

// ###########################################################################################################
//       MODULE LEVEL VARIABLES
// ###########################################################################################################
SYS_HASHMAP_DEFINE_STATIC(uwb_msg_map);

// ###########################################################################################################
//       PRIVATE FUNCTION PROTOTYPES
// ###########################################################################################################

// ###########################################################################################################
//       PUBLIC FUNCTIONS
// ###########################################################################################################

/********************************************************************************
Input:
  ---
Output:
  ---
Description:
  Store message in storage then deliver it to node when node waked up and
connected. 
Author, Date: Toan Huynh, 11/14/2023
*********************************************************************************/
bool host_msg_process_host_msg(uint32_t node_addr,
                               uint8_t* p_data,
                               uint32_t len) {
  if (!p_data || len == 0) {
    return false;
  }

  // Allocate memory for message
  bool ret = false;
  msg_storage_t* buf = k_malloc(sizeof(msg_storage_t));

  if (!buf) {
    return false;
  }

  buf->p_data = k_malloc(len);

  if (buf->p_data) {
    memcpy(buf->p_data, p_data, len);
    buf->data_len = len;

    ret = sys_hashmap_insert(&uwb_msg_map, node_addr, (uintptr_t)buf, NULL) >= 0;

  } else {
    k_free(buf);
  }

  return ret;
}

/********************************************************************************
Input:
  ---
Output:
  ---
Description:
  Send host message to node if found in storage
Author, Date:
  Toan Huynh, 11/14/2023
*********************************************************************************/
bool host_msg_forward_msg_to_node(uint32_t node_addr) {
  uintptr_t value = 0;
  bool ret = sys_hashmap_remove(&uwb_msg_map, node_addr, (void*)&value);

  if (ret) {
    // Verify the message and send it to node
    msg_storage_t* buf = (msg_storage_t*)value;
    hc_package_t package = packet_parse_data(buf->p_data, buf->data_len);

    if (package.p_data) {
      ret = host_msg_send_node_msg(node_addr, buf->p_data, buf->data_len);
    }

    k_free(buf->p_data);
    k_free(buf);
  }

  return ret;
}

/********************************************************************************
Input:
  ---
Output:
  ---
Description:
  ---
Author, Date:
  Toan Huynh, 11/17/2023
*********************************************************************************/
bool host_msg_find_msg(uint32_t node_addr) {
  return sys_hashmap_contains_key(&uwb_msg_map, node_addr);
}

// ###########################################################################################################
//       PRIVATE FUNCTIONS
// ###########################################################################################################

// ###########################################################################################################
//       INTERRUPTS
// ###########################################################################################################

// ###########################################################################################################
//       TEST HARNESSES
// ###########################################################################################################

// ###########################################################################################################
//       END OF dw_msg_manager.c
// ###########################################################################################################
